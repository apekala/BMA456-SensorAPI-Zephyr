## CMakeLists.txt
```
cmake_minimum_required(VERSION 3.20.0)
find_package(Zephyr REQUIRED HINTS $ENV{ZEPHYR_BASE})

project(BMA456-example)

# target_sources(app PRIVATE src/motion.c)
# target_sources(app PRIVATE src/activity.c)
target_sources(app PRIVATE src/step_counter.c)

target_sources(app PRIVATE src/bma4.c)
target_sources(app PRIVATE src/bma456w.c)
target_sources(app PRIVATE src/common.c)
```

## prj.conf
```kconfig
CONFIG_LOG=y
CONFIG_LOG_BLOCK_IN_THREAD=y
CONFIG_LOG_BUFFER_SIZE=4096
CONFIG_SEGGER_RTT_MODE_BLOCK_IF_FIFO_FULL=y

CONFIG_REBOOT=y
CONFIG_POWEROFF=y

CONFIG_SPI=y
```

## src/activity.c
```c
/**\
 * Copyright (c) 2022 Bosch Sensortec GmbH. All rights reserved.
 *
 * SPDX-License-Identifier: BSD-3-Clause
 **/

#include <stdio.h>
#include "bma456w.h"
#include "common.h"

/******************************************************************************/
/*!            Function                                                       */

/* This function starts the execution of program. */
int main(void)
{
    /* Variable to store the status of API */
    int8_t rslt;

    /* Sensor initialization configuration */
    struct bma4_dev bma = { 0 };

    /* Variable to store step activity interrupt status */
    uint16_t int_status = 0;

    /* Variable to hold iteration value */
    uint8_t loop = 1;

    /* Variable to store activity status */
    uint8_t activity_output = 0;

    /* Interface reference is given as a parameter
     *         For I2C : BMA4_I2C_INTF
     *         For SPI : BMA4_SPI_INTF
     * Variant information given as parameter - BMA45X_VARIANT
     */
    rslt = bma4_interface_init(&bma, BMA4_SPI_INTF, BMA45X_VARIANT);
    bma4_error_codes_print_result("bma4_interface_init", rslt);

    /* Sensor initialization */
    rslt = bma456w_init(&bma);
    bma4_error_codes_print_result("bma456w_init status", rslt);

    /* Upload the configuration file to enable the features of the sensor. */
    rslt = bma456w_write_config_file(&bma);
    bma4_error_codes_print_result("bma456w_write_config status", rslt);

    /* Enable the accelerometer */
    rslt = bma4_set_accel_enable(BMA4_ENABLE, &bma);
    bma4_error_codes_print_result("bma4_set_accel_enable status", rslt);

    if (rslt == BMA4_OK)
    {
        /* Map the interrupt 1 for step activity */
        rslt = bma456w_map_interrupt(BMA4_INTR1_MAP, BMA456W_ACTIVITY_INT, BMA4_ENABLE, &bma);
        bma4_error_codes_print_result("bma456w_map_interrupt status", rslt);

        if (rslt == BMA4_OK)
        {
            /* Setting watermark level 1, the output step resolution is 20 steps.
             * Eg: 1 means, 1 * 20 = 20. Every 20 steps once output triggers
             */
            rslt = bma456w_step_counter_set_watermark(1, &bma);
            bma4_error_codes_print_result("bma456w_step_counter_set_watermark status", rslt);

            if (rslt == BMA4_OK)
            {
                /* Enabling step detector feature */
                rslt = bma456w_feature_enable(BMA456W_STEP_ACT, BMA4_ENABLE, &bma);
                bma4_error_codes_print_result("bma456w_feature_enable status", rslt);
            }
        }

        if (rslt == BMA4_OK)
        {
            printf("Move the board in steps to perform step activity\n");

            while (loop <= 5)
            {
                /* Read interrupt status */
                rslt = bma456w_read_int_status(&int_status, &bma);
                bma4_error_codes_print_result("bma456w_read_int_status", rslt);

                /* Filtering only the activity interrupt */
                if ((rslt == BMA4_OK) && (int_status & BMA456W_ACTIVITY_INT))
                {
                    printf("\nIteration : %d\n", loop);

                    /* Get step activity output */
                    rslt = bma456w_activity_output(&activity_output, &bma);
                    bma4_error_codes_print_result("bma456w_activity_output status", rslt);

                    if (rslt == BMA4_OK)
                    {
                        printf("The Activity output is %d\n", activity_output);

                        switch (activity_output)
                        {
                            case BMA456W_USER_STATIONARY:
                                printf("User state is stationary\n");
                                break;
                            case BMA456W_USER_WALKING:
                                printf("User state is walking\n");
                                break;
                            case BMA456W_USER_RUNNING:
                                printf("User state is running\n");
                                break;
                            case BMA456W_STATE_INVALID:
                                printf("User state is invalid state\n");
                                break;
                            default:
                                break;
                        }

                        loop++;
                    }
                }

                int_status = 0;
            }
        }
    }

    bma4_coines_deinit();

    return rslt;
}
```

## src/common.c
```c
/**
 * Copyright (C) 2023 Bosch Sensortec GmbH. All rights reserved.
 *
 * SPDX-License-Identifier: BSD-3-Clause
 */

#include <stdint.h>
#include <stdlib.h>
#include <stdio.h>

#include "bma4_defs.h"
#include "common.h"


#include <zephyr/kernel.h>
#include <zephyr/sys/printk.h>
#include <zephyr/drivers/gpio.h>
#include <zephyr/drivers/spi.h>
#include <zephyr/logging/log.h>
#include <zephyr/logging/log_ctrl.h>

#include <string.h>
#include <stdio.h>

LOG_MODULE_REGISTER(BMA456,LOG_LEVEL_DBG);


#define SPI_BMA  SPI_OP_MODE_MASTER | SPI_MODE_CPHA | SPI_MODE_CPOL  | SPI_WORD_SET(8) | SPI_LINES_SINGLE | SPI_TRANSFER_MSB

// Buffers for communication with bma456
__attribute__((aligned(4))) unsigned char bma456_rbuf[10000];    // buffer for data read from bma456
__attribute__((aligned(4))) unsigned char bma456_wbuf[10000];    // buffer for data written to bma456


//buffer structures
struct spi_buf bmp_tx_bufs[1];
struct spi_buf bmp_rx_bufs[1];

//buffer array
const struct spi_buf_set bptx = {
		.buffers = bmp_tx_bufs,
		.count = ARRAY_SIZE(bmp_tx_bufs)
	};

const struct spi_buf_set bprx = {
		.buffers = bmp_rx_bufs,
		.count = ARRAY_SIZE(bmp_rx_bufs)
	};

const struct spi_dt_spec bma456_dev = SPI_DT_SPEC_GET(DT_NODELABEL(bma456), SPI_BMA, 0);

/******************************************************************************/
/*!                       Macro definitions                                   */

/*! Read write length varies based on user requirement */
#define BMA4_READ_WRITE_LEN  UINT8_C(46)

/******************************************************************************/
/*!                Static variable definition                                 */

/*! Variable that holds the I2C device address or SPI chip selection */
static uint8_t dev_addr;

/******************************************************************************/
/*!                User interface functions                                   */

/*!
 * I2C read function map to COINES platform
 */
// BMA4_INTF_RET_TYPE bma4_i2c_read(uint8_t reg_addr, uint8_t *reg_data, uint32_t len, void *intf_ptr)
// {
//     uint8_t dev_address = *(uint8_t*)intf_ptr;

//     (void)intf_ptr;

//     return coines_read_i2c(COINES_I2C_BUS_0, dev_address, reg_addr, reg_data, (uint16_t)len);
// }

// /*!
//  * I2C write function map to COINES platform
//  */
// BMA4_INTF_RET_TYPE bma4_i2c_write(uint8_t reg_addr, const uint8_t *reg_data, uint32_t len, void *intf_ptr)
// {
//     uint8_t dev_address = *(uint8_t*)intf_ptr;

//     (void)intf_ptr;

//     return coines_write_i2c(COINES_I2C_BUS_0, dev_address, reg_addr, (uint8_t *)reg_data, (uint16_t)len);
// }

/*!
 * SPI read function map to COINES platform
 */
BMA4_INTF_RET_TYPE bma4_spi_read(uint8_t reg_addr, uint8_t *reg_data, uint32_t len, void *intf_ptr)
{

    int ret;
    
    bma456_wbuf[0]= reg_addr | 0x80;
    bma456_wbuf[1]= 0xFF;
    bmp_tx_bufs[0].len=len+2;
    bmp_rx_bufs[0].len=len+2;
    bmp_tx_bufs[0].buf = bma456_wbuf;
    bmp_rx_bufs[0].buf = bma456_rbuf;

    ret = spi_transceive_dt(&bma456_dev, &bptx, &bprx);
    if (ret){
    LOG_ERR("SPI read error address: %d\tlen: %d", reg_addr, len);
    }
    
    for(int i=0; i<len; i++){
        // LOG_WRN("%d: %x", i, bma456_rbuf[i+1]);
        reg_data[i] = bma456_rbuf[i+1];
    }

    return ret;
}

/*!
 * SPI write function map to COINES platform
 */
BMA4_INTF_RET_TYPE bma4_spi_write(uint8_t reg_addr, const uint8_t *reg_data, uint32_t len, void *intf_ptr)
{
    bma456_wbuf[0]= reg_addr & 0x7F;
    // bma456_wbuf[1]= val;
    for(int i =0; i<len; i++){
        bma456_wbuf[i+1]=reg_data[i];
    }

    bmp_tx_bufs[0].buf = bma456_wbuf;
    bmp_rx_bufs[0].buf = bma456_rbuf;
    bmp_tx_bufs[0].len=len+1;
    bmp_rx_bufs[0].len=len+1;

    return  spi_transceive_dt(&bma456_dev, &bptx, &bprx);
}

/*!
 * Delay function map to COINES platform
 */
void bma4_delay_us(uint32_t period, void *intf_ptr)
{
    (void) intf_ptr;
    k_usleep(period);
}

/*!
 *  @brief Function to select the interface between SPI and I2C.
 *  Also to initialize coines platform
 */
int8_t bma4_interface_init(struct bma4_dev *bma, uint8_t intf, enum bma4_variant variant)
{
    int8_t rslt = BMA4_OK;

    if (bma != NULL)
    {
        /* Bus configuration : I2C */
        if (intf == BMA4_I2C_INTF)
        {
            LOG_ERR("I2C unavailable");
            // LOG_ERR("I2C Interface \n");

            // /* To initialize the user I2C function */
            // dev_addr = BMA4_I2C_ADDR_PRIMARY;
            // bma->intf = BMA4_I2C_INTF;
            // bma->bus_read = bma4_i2c_read;
            // bma->bus_write = bma4_i2c_write;

            // /* SDO to Ground */
            // (void)coines_set_pin_config(COINES_SHUTTLE_PIN_22, COINES_PIN_DIRECTION_OUT, COINES_PIN_VALUE_LOW);

            // /* Make CSB pin HIGH */
            // (void)coines_set_pin_config(COINES_SHUTTLE_PIN_21, COINES_PIN_DIRECTION_OUT, COINES_PIN_VALUE_HIGH);
            // coines_delay_msec(100);

            // /* SDO pin is made low */
            // (void)coines_set_pin_config(COINES_SHUTTLE_PIN_SDO, COINES_PIN_DIRECTION_OUT, COINES_PIN_VALUE_LOW);

            // (void)coines_config_i2c_bus(COINES_I2C_BUS_0, COINES_I2C_STANDARD_MODE);
        }
        /* Bus configuration : SPI */
        else if (intf == BMA4_SPI_INTF)
        {
            

            /* To initialize the user SPI function */
            // dev_addr = COINES_SHUTTLE_PIN_7; // chyba niepotrzebne
            bma->intf = BMA4_SPI_INTF;
            bma->bus_read = bma4_spi_read;
            bma->bus_write = bma4_spi_write;
            // (void)coines_config_spi_bus(COINES_SPI_BUS_0, COINES_SPI_SPEED_7_5_MHZ, COINES_SPI_MODE0);
            LOG_INF("SPI interface configured");
        }

        /* Assign variant information */
        bma->variant = variant;

        /* Assign device address to interface pointer */
        bma->intf_ptr = &dev_addr;

        /* Configure delay in microseconds */
        bma->delay_us = bma4_delay_us;

        /* Configure max read/write length (in bytes) ( Supported length depends on target machine) */
        bma->read_write_len = BMA4_READ_WRITE_LEN;

        /* Set Performance mode status */
        bma->perf_mode_status = BMA4_DISABLE;

        k_msleep(100);

        // (void)coines_set_shuttleboard_vdd_vddio_config(3300, 3300);

        k_msleep(200);
    }
    else
    {
        rslt = BMA4_E_NULL_PTR;
    }

    return rslt;

}
/*!
 *  @brief Prints the execution status of the APIs.
 */
void bma4_error_codes_print_result(const char api_name[], int8_t rslt)
{
    if (rslt != BMA4_OK)
    {
        LOG_ERR("%s\t", api_name);
        if (rslt == BMA4_E_NULL_PTR)
        {
            LOG_ERR("Error [%d] : Null pointer\r\n", rslt);
        }
        else if (rslt == BMA4_E_COM_FAIL)
        {
            LOG_ERR("Error [%d] : Communication failure\r\n", rslt);
        }
        else if (rslt == BMA4_E_CONFIG_STREAM_ERROR)
        {
            LOG_ERR("Error [%d] : Invalid configuration stream\r\n", rslt);
        }
        else if (rslt == BMA4_E_SELF_TEST_FAIL)
        {
            LOG_ERR("Error [%d] : Self test failed\r\n", rslt);
        }
        else if (rslt == BMA4_E_INVALID_SENSOR)
        {
            LOG_ERR("Error [%d] : Device not found\r\n", rslt);
        }
        else if (rslt == BMA4_E_OUT_OF_RANGE)
        {
            LOG_ERR("Error [%d] : Out of Range\r\n", rslt);
        }
        else if (rslt == BMA4_E_AVG_MODE_INVALID_CONF)
        {
            LOG_ERR("Error [%d] : Invalid bandwidth and ODR combination in Accel Averaging mode\r\n", rslt);
        }
        else
        {
            /* For more error codes refer "*_defs.h" */
            LOG_ERR("Error [%d] : Unknown error code\r\n", rslt);
        }
    }
}

/*!
 *  @brief Deinitializes coines platform
 *
 *  @return void.
 */
void bma4_coines_deinit(void)
{
    // (void)fflush(stdout);
    // coines_delay_msec(200);

    // (void)coines_set_shuttleboard_vdd_vddio_config(0, 0);
    // coines_delay_msec(1000);

    // /* Coines interface reset */
    // coines_soft_reset();
    // coines_delay_msec(1000);
    // (void)coines_close_comm_intf(COINES_COMM_INTF_USB, NULL);
}
```

## src/motion.c
```c
/**\
 * Copyright (c) 2022 Bosch Sensortec GmbH. All rights reserved.
 *
 * SPDX-License-Identifier: BSD-3-Clause
 **/

#include <stdio.h>

#include <zephyr/logging/log.h>
#include <zephyr/logging/log_ctrl.h>

#include "bma456w.h"
#include "common.h"


LOG_MODULE_REGISTER(main ,LOG_LEVEL_DBG);
/*****************************************************************************/
/*!                Global variable                                           */

/*! Structure to define any/no-motion configurations */
struct bma456w_any_no_mot_config any_no_mot = { 0 };

/******************************************************************************/
/*!           Static Function Declaration                                     */

/*!
 *  @brief This internal API is used to get any/no-motion configurations.
 *
 *  @param[in] bma       : Structure instance of bma4_dev.
 *
 *  @return Status of execution.
 */
static int8_t get_any_no_mot_config(struct bma4_dev *bma);

/******************************************************************************/
/*!            Functions                                                      */

/* This function starts the execution of program. */
int main(void)
{
    /* Variable to store the status of API */
    int8_t rslt;

    /* Sensor initialization configuration */
    struct bma4_dev bma = { 0 };

    /* Variable to store any/no-motion interrupt status */
    uint16_t int_status = 0;

    /* Loop variable */
    uint8_t iteration = 200;

    /* Interface reference is given as a parameter
     *         For I2C : BMA4_I2C_INTF
     *         For SPI : BMA4_SPI_INTF
     * Variant information given as parameter - BMA45X_VARIANT
     */
    rslt = bma4_interface_init(&bma, BMA4_SPI_INTF, BMA45X_VARIANT);
    bma4_error_codes_print_result("bma4_interface_init", rslt);

    /* Sensor initialization */
    rslt = bma456w_init(&bma);
    bma4_error_codes_print_result("bma456w_init status", rslt);

    /* Upload the configuration file to enable the features of the sensor. */
    rslt = bma456w_write_config_file(&bma);
    bma4_error_codes_print_result("bma456w_write_config status", rslt);

    /* Enable the accelerometer */
    rslt = bma4_set_accel_enable(BMA4_ENABLE, &bma);
    bma4_error_codes_print_result("bma4_set_accel_enable status", rslt);

    /* Map the interrupt 1 for any/no-motion */
    rslt = bma456w_map_interrupt(BMA4_INTR1_MAP, (BMA456W_ANY_MOT_INT | BMA456W_NO_MOT_INT), BMA4_ENABLE, &bma);
    bma4_error_codes_print_result("bma456w_map_interrupt status", rslt);

    /* Get any-motion and no-motion configurations */
    rslt = get_any_no_mot_config(&bma);
    bma4_error_codes_print_result("get_any_no_mot_config status", rslt);

    printf("Shake the board for any-motion interrupt whereas do not shake the board for no-motion interrupt\n");

    for (;;)
    {
        /* Read interrupt status */
        rslt = bma456w_read_int_status(&int_status, &bma);
        bma4_error_codes_print_result("bma456w_read_int_status", rslt);

        

        if (rslt == BMA4_OK)
        {
            
            /* Enters only if the obtained interrupt is any-motion */
            if (int_status & BMA456W_ANY_MOT_INT)
            {
                printf("Any-motion interrupt occurred\n");
                iteration--;
            }

            /* Enters only if the obtained interrupt is no-motion */
            else if (int_status & BMA456W_NO_MOT_INT)
            {
                printf("No-motion interrupt occurred\n");
                iteration--;
            }

            int_status = 0;

            /* Break out of the loop when iteration has reached zero */
            if (iteration == 0)
            {
                printf("Iterations are done. Exiting !");
                break;
            }
        }
    }

    bma4_coines_deinit();

    return rslt;
}

/*!
 *  @brief This internal API is used to get any/no-motion configurations.
 */
static int8_t get_any_no_mot_config(struct bma4_dev *bma)
{
    /* Variable to store the status of API */
    int8_t rslt;

    /* Getting any-motion configuration to get default configuration */
    rslt = bma456w_get_any_mot_config(&any_no_mot, bma);
    bma4_error_codes_print_result("bma456w_get_any_mot_config status", rslt);

    if (rslt == BMA4_OK)
    {
        /*
         * Set the slope threshold:
         *  Interrupt will be generated if the slope of all the axis exceeds the threshold (1 bit = 0.48mG)
         */
        any_no_mot.threshold = 10;

        /*
         * Set the duration for any-motion interrupt:
         *  Duration defines the number of consecutive data points for which threshold condition must be true(1
         * bit =
         * 20ms)
         */
        any_no_mot.duration = 4;

        /* Enabling X, Y, and Z axis for Any-motion feature */
        any_no_mot.axes_en = BMA456W_EN_ALL_AXIS;

        /* Like threshold and duration, we can also change the config of int_bhvr and slope */

        /* Set the threshold and duration configuration */
        rslt = bma456w_set_any_mot_config(&any_no_mot, bma);
        bma4_error_codes_print_result("bma456w_set_any_mot_config status", rslt);

        if (rslt == BMA4_OK)
        {
            /* Getting no-motion configuration to get default configuration */
            rslt = bma456w_get_no_mot_config(&any_no_mot, bma);
            bma4_error_codes_print_result("bma456w_get_no_mot_config status", rslt);

            if (rslt == BMA4_OK)
            {
                /*
                 * Set the slope threshold:
                 *  Interrupt will be generated if the slope of all the axis exceeds the threshold (1 bit = 0.48mG)
                 */
                any_no_mot.threshold = 10;

                /*
                 * Set the duration for no-motion interrupt:
                 * Duration defines the number of consecutive data points for which threshold condition must be
                 * true(1 bit = 20ms)
                 */
                any_no_mot.duration = 4;

                /* Enabling X, Y, and Z axis for no-motion feature */
                any_no_mot.axes_en = BMA456W_EN_ALL_AXIS;

                /* Like threshold and duration, we can also change the config of int_bhvr */

                /* Set the threshold and duration configuration */
                rslt = bma456w_set_no_mot_config(&any_no_mot, bma);
                bma4_error_codes_print_result("bma456w_set_no_mot_config status", rslt);
            }
        }
    }

    return rslt;
}
```

## src/step_counter.c
```c
/**\
 * Copyright (c) 2022 Bosch Sensortec GmbH. All rights reserved.
 *
 * SPDX-License-Identifier: BSD-3-Clause
 **/

#include <stdio.h>
#include "bma456w.h"
#include "common.h"

LOG_MODULE_REGISTER(main ,LOG_LEVEL_DBG);
/******************************************************************************/
/*!            Function                                                       */

/* This function starts the execution of program. */
int main(void)
{
    /* Variable to store the status of API */
    int8_t rslt;

    /* Sensor initialization configuration */
    struct bma4_dev bma = { 0 };

    /* Variable to store step counter interrupt status */
    uint16_t int_status = 0;

    /* Variable to store step counter status */
    uint32_t step_out = 0;

    /* Interface reference is given as a parameter
     *         For I2C : BMA4_I2C_INTF
     *         For SPI : BMA4_SPI_INTF
     * Variant information given as parameter - BMA45X_VARIANT
     */
    rslt = bma4_interface_init(&bma, BMA4_SPI_INTF, BMA45X_VARIANT);
    bma4_error_codes_print_result("bma4_interface_init", rslt);

    /* Sensor initialization */
    rslt = bma456w_init(&bma);
    bma4_error_codes_print_result("bma456w_init status", rslt);

    /* Upload the configuration file to enable the features of the sensor. */
    rslt = bma456w_write_config_file(&bma);
    bma4_error_codes_print_result("bma456w_write_config status", rslt);

    /* Enable accelerometer to perform feature testing */
    rslt = bma4_set_accel_enable(BMA4_ENABLE, &bma);
    bma4_error_codes_print_result("bma4_set_accel_enable status", rslt);

    rslt = bma456w_feature_enable(BMA456W_STEP_CNTR, BMA4_ENABLE, &bma);
    bma4_error_codes_print_result("bma456w_feature_enable status", rslt);

    rslt = bma456w_map_interrupt(BMA4_INTR1_MAP, BMA456W_STEP_CNTR_INT, BMA4_ENABLE, &bma);
    bma4_error_codes_print_result("bma456w_map_interrupt status", rslt);

    /* Setting watermark level 1, the output step resolution is 20 steps.
     * Eg: 1 means, 1 * 20 = 20. Every 20 steps once output triggers
     */
    rslt = bma456w_step_counter_set_watermark(1, &bma);
    bma4_error_codes_print_result("bma456w_step_counter_set_watermark status", rslt);

    printf("Step counter feature is enabled\n");

    printf("Step counter watermark level is 1 (Output resolution is 20 steps)\n");

    printf("Move the board in steps for greater than 3 seconds\n");

    /* Loop over until step counter interrupt occurs */
    // for (;;)
    // {
    //     /* Read the interrupt status (After 20 steps, generates interrupt) */
    //     rslt = bma456w_read_int_status(&int_status, &bma);
    //     bma4_error_codes_print_result("bma456w_read_int_status", rslt);

    //     if ((BMA4_OK == rslt) && (int_status & BMA456W_STEP_CNTR_INT))
    //     {
    //         printf("Step counter interrupt received when watermark level is reached (20 steps)\n");

    //         /* Get the step counter output after reset */
    //         rslt = bma456w_step_counter_output(&step_out, &bma);
    //         bma4_error_codes_print_result("bma456w_step_counter_output status", rslt);

    //         break;
    //     }
    // }
    
    for(;;){
        rslt = bma456w_step_counter_output(&step_out, &bma);
        LOG_INF("Steps: %d", step_out);
        bma4_error_codes_print_result("bma456w_step_counter_output status", rslt);
        k_msleep(1000);
    }

    printf("The step counter output is %lu \n", (long unsigned int)step_out);

    bma4_coines_deinit();

    return rslt;
}
```
